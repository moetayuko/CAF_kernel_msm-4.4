## Documentation/devicetree/bindings/serial/slave-device.txt
```
Serial Slave Device DT binding

This documents the binding structure and common properties for serial
attached devices. Common examples include Bluetooth, WiFi, NFC and GPS
devices.

qSerial attached devices shall be a child node of the host UART device the
slave device is attached to. It is expected that the attached device is
the only child node of the UART device. The slave device node name shall
reflect the generic type of device for the node.

Required Properties:

- compatible 	: A string reflecting the vendor and specific device the node
		  represents.

Optional Properties:

- reg		: A single cell representing the port/line number of the
		  host UART. Only used if the host UART is a single node
		  with multiple ports.

Example:

serial@1234 {
	compatible = "ns16550a";
	interrupts = <1>;

	bluetooth {
		compatible = "brcm,bcm43341-bt";
		interrupt-parent = <&gpio>;
		interrupts = <10>;
	};
};
```

## drivers/net/ethernet/msm/Kconfig
```kconfig
#
# msm network device configuration
#

config MHI_NETDEV
	bool "MHI net device driver support"
	depends on MSM_MHI
	help
	  Implements IP traffic over MHI interface.
	  MHI netdev driver provides a virtual ethernet interface
	  for routing IP packets to external modem via
	  PCIe interface using MHI transport protocol.

config ECM_IPA
	tristate "STD ECM LAN Driver support"
	depends on IPA || IPA3
	help
	  Enables LAN between applications processor and a tethered
	  host using the STD ECM protocol.
	  This Network interface is aimed to allow data path go through
	  IPA core while using STD ECM protocol.

config RNDIS_IPA
	tristate "RNDIS_IPA Network Interface Driver support"
	depends on IPA || IPA3
	help
	  Enables LAN between applications processor and a tethered
	  host using the RNDIS protocol.
	  This Network interface is aimed to allow data path go through
	  IPA core while using RNDIS protocol.
```
